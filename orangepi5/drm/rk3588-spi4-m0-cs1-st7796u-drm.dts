/dts-v1/;
/plugin/;

/ {

        fragment@0 {
                target = <&spi4>;
                __overlay__ {
                        status = "okay";

			tft: st7796u@1 {
                                #address-cells = <1>;
                                #size-cells = <1>;
                        	compatible = "yaoyuanhong,yt350s006";
                        	reg = <1>;
                        	spi-max-frequency = <30000000>;
                        	dc-gpios = <&gpio0 28 0>;
                        	reset-gpios = <&gpio2 28 0>;
				rotation = <90>;
				led-gpios = <&gpio1 26 1>;
                        	status = "okay";
                	};
                };
        };
};
