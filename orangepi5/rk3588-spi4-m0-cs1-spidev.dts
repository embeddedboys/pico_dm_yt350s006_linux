/dts-v1/;

/ {

	fragment@0 {
		target = <0xffffffff>;

		__overlay__ {
			status = "okay";
			#address-cells = <0x01>;
			#size-cells = <0x00>;
			pinctrl-names = "default";
			pinctrl-0 = <0xffffffff 0xffffffff>;

			spidev@1 {
				compatible = "rockchip,spidev";
				status = "okay";
				reg = <0x01>;
				spi-max-frequency = <0x2faf080>;
			};
		};
	};

	__fixups__ {
		spi4 = "/fragment@0:target:0";
		spi4m0_cs1 = "/fragment@0/__overlay__:pinctrl-0:0";
		spi4m0_pins = "/fragment@0/__overlay__:pinctrl-0:4";
	};
};
