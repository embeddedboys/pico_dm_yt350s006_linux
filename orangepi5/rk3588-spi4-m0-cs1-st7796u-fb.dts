/dts-v1/;
/plugin/;

/ {

        fragment@0 {
                target = <&spi4>;
                __overlay__ {
                        status = "okay";

			tft: st7796u@1 {
                        	#address-cells = <1>;
                        	#size-cells = <1>;
                        	compatible = "sitronix,st7796u";
                        	reg = <0x1>;
                        	spi-max-frequency = <100000000>;
                        	buswidth = <8>;
                        	xres = <480>;
                        	yres = <320>;
                        	spi-cpol;
                        	spi-cpha;
                        	blk-gpios = <&gpio1 26 1>;
                        	dc-gpios = <&gpio0 28 1>;
                        	reset-gpios = <&gpio2 28 1>;
                        	debug = <1>;
                        	status = "okay";
                	};
                };
        };
};
