/dts-v1/;
/plugin/;

/ {
        compatible = "brcm,bcm2835";

        fragment@0 {
            target = <&spi0>;
            __overlay__ {
                status = "okay";
                tft: st7796u@0 {
                        #address-cells = <1>;
                        #size-cells = <1>;
                        compatible = "yaoyuanhong,yt350s006";
                        reg = <0>;
                        spi-max-frequency = <100000000>;
			led-gpios = <&gpio 24 0>;
			dc-gpios = <&gpio 22 0>;
			rotation = <90>;
			reset-gpios = <&gpio 25 0>;
                        status = "okay";
                };
            };
        };
};
