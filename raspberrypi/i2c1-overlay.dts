/dts-v1/;
/plugin/;

/ {
    compatible = "brcm,bcm2835";

    fragment@0 {
        target = <&i2c_arm>;
        __overlay__ {
            status = "okay";
            gt911@14 {
                compatible = "goodix,gt911";
                reg = <0x14>;
                // pinctrl-names = "default";
                // pinctrl-0 = <&goodix_ts_pins>;
                interrupt-parent = <&gpio>;
                interrupts = <23 2>;
                irq-gpios = <&gpio 23 1>;
                reset-gpios = <&gpio 18 1>;
		touchscreen-swapped-x-y;
		touchscreen-inverted-x;
            };
        };
    };
};
